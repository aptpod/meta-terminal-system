## meta-terminal-system-core/conf/distro/terminal-system-os-2.conf
```bitbake
require conf/distro/poky.conf

DISTRO = "terminal-system-os-2"
DISTRO_NAME = "Terminal System OS 2 (Yocto Project Distro)"
DISTRO_VERSION = "${TS_DISTRO_VERSION}"
DISTRO_VERSION_BUILD_METADATA = "${@bb.utils.contains('TS_DISTRO_VERSION', 'develop', \
                                    '+${TS_DISTRO_VERSION_BUILD_METADATA}' if d.getVar('TS_DISTRO_VERSION_BUILD_METADATA') else '+${DATETIME}', \
                                    '+${TS_DISTRO_VERSION_BUILD_METADATA}' if d.getVar('TS_DISTRO_VERSION_BUILD_METADATA') else '', d)}"
DISTRO_VERSION_BUILD_METADATA[vardepsexclude] += "TS_DISTRO_VERSION_BUILD_METADATA DATETIME"

DISTRO_FEATURES:append = " systemd virtualization"
VIRTUAL-RUNTIME_init_manager = "systemd"
DISTRO_FEATURES_BACKFILL_CONSIDERED = "sysvinit"
# avoid conflicts between avahi-daemon and systemd-resolved for mDNS support
DISTRO_FEATURES:remove = " zeroconf"

INHERIT += "extrausers"
EXTRA_USERS_PARAMS = "usermod root"

VOLATILE_LOG_DIR = "no"

PACKAGE_CLASSES ?= "package_deb"

TS_RESOURCES_DIR ?= "${HOME}"

# Used in docker-ce_%.bbappend to install docker-compose-plugin
HOSTTOOLS += "docker"
# Used in docker-archive-load.bb to install pre-install docker image
HOSTTOOLS += "aws jq"
```

## meta-terminal-system-core/conf/layer.conf
```bitbake
# We have a conf and classes directory, add to BBPATH
BBPATH .= ":${LAYERDIR}"

# We have recipes-* directories, add to BBFILES
BBFILES += "${LAYERDIR}/recipes-*/*/*.bb \
	${LAYERDIR}/recipes-*/*/*.bbappend"

BBFILE_COLLECTIONS += "terminal-system-layer"
BBFILE_PATTERN_terminal-system-layer = "^${LAYERDIR}/"

LAYERDEPENDS_terminal-system-layer += "core"
LAYERDEPENDS_terminal-system-layer += "openembedded-layer"
LAYERDEPENDS_terminal-system-layer += "networking-layer"
LAYERDEPENDS_terminal-system-layer += "webserver"
LAYERDEPENDS_terminal-system-layer += "virtualization-layer"
LAYERDEPENDS_terminal-system-layer += "mender"
LAYERDEPENDS_terminal-system-layer += "mender-commercial"
LAYERDEPENDS_terminal-system-layer += "mender-update-modules"

LAYERSERIES_COMPAT_terminal-system-layer = "kirkstone"
```

## meta-terminal-system-edgeplant/conf/layer.conf
```bitbake
# We have a conf and classes directory, add to BBPATH
BBPATH .= ":${LAYERDIR}"

# We have recipes-* directories, add to BBFILES
BBFILES += "${LAYERDIR}/recipes-*/*/*.bb \
	${LAYERDIR}/recipes-*/*/*.bbappend"

BBFILE_COLLECTIONS += "terminal-system-edgeplant-layer"
BBFILE_PATTERN_terminal-system-edgeplant-layer = "^${LAYERDIR}/"

LAYERDEPENDS_terminal-system-edgeplant-layer += "terminal-system-layer"
LAYERDEPENDS_terminal-system-edgeplant-layer += "terminal-system-tegra-layer"
LAYERDEPENDS_terminal-system-edgeplant-layer += "meta-edgeplant"

LAYERSERIES_COMPAT_terminal-system-edgeplant-layer = "kirkstone"
```

## meta-terminal-system-raspberrypi/conf/layer.conf
```bitbake
# We have a conf and classes directory, add to BBPATH
BBPATH .= ":${LAYERDIR}"

# We have recipes-* directories, add to BBFILES
BBFILES += "${LAYERDIR}/recipes-*/*/*.bb \
	${LAYERDIR}/recipes-*/*/*.bbappend"

BBFILE_COLLECTIONS += "terminal-system-raspberrypi-layer"
BBFILE_PATTERN_terminal-system-raspberrypi-layer = "^${LAYERDIR}/"

LAYERDEPENDS_terminal-system-raspberrypi-layer += "terminal-system-layer"
LAYERDEPENDS_terminal-system-raspberrypi-layer += "raspberrypi"
LAYERDEPENDS_terminal-system-raspberrypi-layer += "mender-raspberrypi"

LAYERSERIES_COMPAT_terminal-system-raspberrypi-layer = "kirkstone"
```

## meta-terminal-system-tegra/conf/layer.conf
```bitbake
# We have a conf and classes directory, add to BBPATH
BBPATH .= ":${LAYERDIR}"

# We have recipes-* directories, add to BBFILES
BBFILES += "${LAYERDIR}/recipes-*/*/*.bb \
	${LAYERDIR}/recipes-*/*/*.bbappend"

BBFILE_COLLECTIONS += "terminal-system-tegra-layer"
BBFILE_PATTERN_terminal-system-tegra-layer = "^${LAYERDIR}/"

LAYERDEPENDS_terminal-system-tegra-layer += "terminal-system-layer"
LAYERDEPENDS_terminal-system-tegra-layer += "tegra"
LAYERDEPENDS_terminal-system-tegra-layer += "meta-mender-tegra"

LAYERSERIES_COMPAT_terminal-system-tegra-layer = "kirkstone"
```
